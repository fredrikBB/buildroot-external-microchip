## board/microchip/beaglev_fire_amp/mpfs-beaglev-fire-amp.its
```
// SPDX-License-Identifier: (GPL-2.0+ OR MIT)
/*
 * Flattened Image Tree file for BeagleV-Fire AMP
 * Uses base device tree + overlay approach like Icicle AMP
 */

/dts-v1/;

/ {
    description = "U-Boot fitImage for BeagleV-Fire AMP";
    #address-cells = <2>;

    images {
        kernel {
            description = "Linux kernel";
            data = /incbin/("Image.gz");
            type = "kernel";
            arch = "riscv";
            os = "linux";
            compression = "gzip";
            load = <0x0 0x80200000>;
            entry = <0x0 0x80200000>;
            hash-1 {
                algo = "sha256";
            };
        };

        fdt {
            description = "BeagleV-Fire base device tree";
            data = /incbin/("dts/microchip/mpfs-beaglev-fire.dtb");
            type = "flat_dt";
            arch = "riscv";
            compression = "none";
            load = <0x0 0x8a000000>;
            hash-1 {
                algo = "sha256";
            };
        };

        fdt-mpfs-beaglev-fire-amp.dtbo {
            description = "BeagleV-Fire AMP overlay";
            data = /incbin/("mpfs_beaglev_fire/mpfs_beaglev_fire_amp.dtbo");
            type = "flat_dt";
            arch = "riscv";
            compression = "none";
            load = <0x0 0x8a080000>;
            hash-1 {
                algo = "sha256";
            };
        };
    };

    configurations {
        default = "conf-microchip,mpfs-beaglev-fire";

        conf-microchip,mpfs-beaglev-fire {
            description = "BeagleV-Fire base configuration";
            kernel = "kernel";
            fdt = "fdt";
            hash-1 {
                algo = "sha256";
            };
        };

        conf-microchip,mpfs-beaglev-fire-amp {
            description = "BeagleV-Fire AMP overlay";
            fdt = "fdt-mpfs-beaglev-fire-amp.dtbo";
        };
    };
};
```

## board/microchip/beaglev_fire_amp/mpfs_beaglev_fire.its
```
// SPDX-License-Identifier: (GPL-2.0+ OR MIT)
/*
 * Flattened Image Tree file for BeagleV-Fire AMP
 *
 */

/dts-v1/;

/ {
	description = "U-Boot fitImage for BeagleV-Fire AMP";
	address-cells = <1>;

		images {
			kernel {
				description = "Linux kernel";
				data = /incbin/("./Image.gz");
				type = "kernel";
				arch = "riscv";
				os = "linux";
				compression = "gzip";
				load = <0x80200000>;
				entry = <0x80200000>;
				hash-1 {
					algo = "sha256";
				};
			};
			base_fdt {
				description = "Flattened Device Tree blob";
				data = /incbin/("./mpfs-beaglev-fire.dtb");
				type = "flat_dt";
				arch = "riscv";
				compression = "none";
				load = <0x8a000000>;
				hash-1 {
					algo = "sha256";
				};
			};
		};

		configurations {
			default = "kernel_dtb";
			kernel_dtb {
				description = "1 Linux kernel, FDT blob";
				kernel = "kernel";
				fdt = "base_fdt";
			};

			base_dtb {
				description = "Base FDT blob for BeagleV-Fire board";
				fdt = "base_fdt";
			};

			conf-microchip,beaglev-fire {
				description = "BeagleV-Fire configuration";
				kernel = "kernel";
				fdt = "base_fdt";
			};

			conf-microchip,beaglev-fire-amp {
				description = "BeagleV-Fire AMP configuration";
				kernel = "kernel";
				fdt = "base_fdt";
			};
		};
};
```

## package/dt-overlay-mchp/beaglev-fire-files/mpfs_beaglev_fire.its
```
// SPDX-License-Identifier: (GPL-2.0+ OR MIT)
/*
 * Flattened Image Tree file for BeagleV-Fire
 *
 * Copyright (C) 2022 Microchip Technology Inc. and its subsidiaries.
 * Author: Conor Dooley <conor.dooley@microchip.com>
 * Adapted for BeagleV-Fire by buildroot-external-microchip
 *
 */

/dts-v1/;

/ {
	description = "U-Boot fitImage for the MPFS BeagleV-Fire";
	#address-cells = <2>;

		images {
			kernel {
				description = "Linux kernel";
				data = /incbin/("./Image.gz");
				type = "kernel";
				arch = "riscv";
				os = "linux";
				compression = "gzip";
				load = <0x80200000>;
				entry = <0x80200000>;
				hash-1 {
					algo = "sha256";
				};
			};
			fdt-beagle-beaglev-fire.dtb {
				description = "Flattened Device Tree blob";
				data = /incbin/("./dts/microchip/mpfs-beaglev-fire.dtb");
				type = "flat_dt";
				arch = "riscv";
				compression = "none";
				load = <0x8a000000>;
				hash-1 {
					algo = "sha256";
				};
			};
			fdt-mpfs-beaglev-fire-amp.dtbo {
				description = "Device Tree blob for AMP";
				data = /incbin/("./mpfs_beaglev_fire/mpfs_beaglev_fire_amp.dtbo");
				type = "flat_dt";
				arch = "riscv";
				compression = "none";
				load = <0x8a0b0000>;
				hash-1 {
					algo = "sha256";
				};
			};
		};

		configurations {
			default = "conf-beagle,beaglev-fire";
			conf-beagle,beaglev-fire {
				description = "1 Linux kernel, FDT blob";
				kernel = "kernel";
				fdt = "fdt-beagle-beaglev-fire.dtb";
			};

			conf-beagle,mpfs-beaglev-fire-amp {
				description = "FDT overlay blob for AMP";
				fdt = "fdt-mpfs-beaglev-fire-amp.dtbo";
			};

			conf-beagle,fdt-beagle-beaglev-fire.dtb {
				description = "Base FDT blob for MPFS BeagleV-Fire board";
				fdt = "fdt-beagle-beaglev-fire.dtb";
			};
		};
};
```
